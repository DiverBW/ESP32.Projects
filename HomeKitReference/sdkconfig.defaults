## HomeKitReference/sdkconfig.defaults
```kconfig
# HomeKit Reference Application - ESP32-C6 Configuration

# Target chip
CONFIG_IDF_TARGET="esp32c6"

# Flash size (4MB typical for dev boards)
CONFIG_ESPTOOLPY_FLASHSIZE_4MB=y

# Partition table (use custom for HomeKit factory NVS)
CONFIG_PARTITION_TABLE_CUSTOM=y
CONFIG_PARTITION_TABLE_CUSTOM_FILENAME="partitions.csv"

# WiFi
CONFIG_ESP_WIFI_SOFTAP_SUPPORT=y
CONFIG_ESP_WIFI_NVS_ENABLED=y

# mDNS (required for HomeKit discovery)
CONFIG_MDNS_MAX_SERVICES=10

# NVS
CONFIG_NVS_ENCRYPTION=n

# ESP-TLS (required for HomeKit secure pairing)
CONFIG_ESP_TLS_SERVER=y

# LWIP (increase sockets for HomeKit HAP server)
CONFIG_LWIP_MAX_SOCKETS=16

# FreeRTOS
CONFIG_FREERTOS_HZ=1000

# Logging
CONFIG_LOG_DEFAULT_LEVEL_INFO=y
CONFIG_LOG_MAXIMUM_LEVEL_DEBUG=y

# Stack sizes
CONFIG_ESP_MAIN_TASK_STACK_SIZE=8192
CONFIG_ESP_SYSTEM_EVENT_TASK_STACK_SIZE=4096

# HomeKit requires MbedTLS with specific features
CONFIG_MBEDTLS_HARDWARE_AES=y
CONFIG_MBEDTLS_HARDWARE_SHA=y
CONFIG_MBEDTLS_TLS_SERVER=y
CONFIG_MBEDTLS_TLS_CLIENT=y
CONFIG_MBEDTLS_SSL_PROTO_TLS1_2=y
CONFIG_MBEDTLS_KEY_EXCHANGE_RSA=y
CONFIG_MBEDTLS_KEY_EXCHANGE_ECDHE_RSA=y
CONFIG_MBEDTLS_KEY_EXCHANGE_ECDHE_ECDSA=y
CONFIG_MBEDTLS_ECP_DP_SECP256R1_ENABLED=y
CONFIG_MBEDTLS_ECP_DP_CURVE25519_ENABLED=y

# Compiler optimization
CONFIG_COMPILER_OPTIMIZATION_SIZE=y
```
